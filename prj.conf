## prj.conf
```kconfig
CONFIG_BT=y
CONFIG_BT_BROADCASTER=y
CONFIG_BT_OBSERVER=y
CONFIG_LOG=n
CONFIG_SETTINGS=n
CONFIG_FLASH=y
CONFIG_NVS=y
CONFIG_SETTINGS_NVS=n
#CONFIG_BT_PERIPHERAL=y
CONFIG_TEST_RANDOM_GENERATOR=y
CONFIG_ENTROPY_GENERATOR=y

# Allow 1 connection (enough for DFU / future stuff)
#CONFIG_BT_MAX_CONN=1
#CONFIG_BT_MAX_PAIRED=1

# Use factory-programmed public address
CONFIG_BT_PRIVACY=n
CONFIG_BT_CTLR_PRIVACY=n
CONFIG_BT_SCAN_WITH_IDENTITY=y
CONFIG_BT_CTLR_TX_PWR_MINUS_20=y

# Power optimization - reduce BLE stack overhead
#CONFIG_BT_CTLR_LOW_LAT=n
#CONFIG_BT_CTLR_FAST_ENC=n
#CONFIG_BT_CTLR_CONN_RSSI=n

# Minimize buffer allocations to reduce RAM and processing overhead
#CONFIG_BT_BUF_EVT_RX_COUNT=2
#CONFIG_BT_BUF_EVT_DISCARDABLE_COUNT=1
#CONFIG_BT_BUF_CMD_TX_COUNT=2
#CONFIG_BT_CTLR_RX_BUFFERS=1
#CONFIG_BT_CTLR_DATA_LENGTH_MAX=27

# PWM support for LED brightness control
CONFIG_CAF_LEDS_PWM=y
CONFIG_PWM=y
CONFIG_LED=y
CONFIG_LED_PWM=y
```

## src/LEDManager.c
```c
#include "LEDManager.h"
#include <zephyr/kernel.h>
#include <string.h>
#include <stdlib.h>


static struct led_entry *leds = NULL;
static int led_count = 0;
static uint8_t led_brightness = 50; // Default 50% brightness

// Helper function to set PWM brightness
static void set_pwm_for_led(const struct pwm_dt_spec *pwm, bool on, uint8_t brightness) {
    if (!pwm || !pwm->dev) {
        return; // No PWM configured
    }
    
    uint32_t period = pwm->period;
    uint32_t pulse = on ? (period * brightness / 100) : 0;
    
    pwm_set_dt(pwm, period, pulse);
}

int init_led_manager(struct led_entry *led_array, int count)
{
    leds = led_array;
    if (!leds) return -1;
    led_count = count;
    for (int i = 0; i < count; ++i) {
        leds[i].state = LED_OFF;
        
        if (!leds[i].pwm || !leds[i].pwm->dev) {
            return -2; // PWM is required
        }
        if (!device_is_ready(leds[i].pwm->dev)) {
            return -3;
        }
        // Set LED OFF initially
        set_pwm_for_led(leds[i].pwm, false, 0);
    }
    return 0;
}

int set_led_state(int led_idx, enum led_state state)
{
    if (led_idx < 0 || led_idx >= led_count) return -1;
    leds[led_idx].state = state;
    return 0;
}

int set_led_brightness(int led_idx, uint8_t brightness_percent)
{
    if (brightness_percent > 100) brightness_percent = 100;
    
    if (led_idx < 0) {
        // Set global brightness for all LEDs
        led_brightness = brightness_percent;
        return 0;
    }
    
    if (led_idx >= led_count) return -1;
    
    // Update specific LED if it's currently ON
    if (leds[led_idx].state == LED_ON) {
        set_pwm_for_led(leds[led_idx].pwm, true, brightness_percent);
    }
    
    return 0;
}

// Operate LEDs for a total interval, toggling blinking LEDs at the given blink interval
void operate_leds(int total_interval_ms, int blink_interval_ms)
{
    int elapsed = 0;
    bool blink_state = false;
    // Synchronize state to new_state once at the start
    for (int i = 0; i < led_count; i++) {
        // set ONs and OFFs immediately
        if (leds[i].state == LED_ON) {
            set_pwm_for_led(leds[i].pwm, true, led_brightness);
        } else if (leds[i].state == LED_OFF) {
            set_pwm_for_led(leds[i].pwm, false, 0);
        }
    }

    while (elapsed < total_interval_ms) {
        blink_state = !blink_state;
        for (int i = 0; i < led_count; i++) {
            if (leds[i].state == LED_BLINK_FAST) {
                set_pwm_for_led(leds[i].pwm, blink_state, led_brightness);
            }
            if (leds[i].state == LED_BLINK_ONCE) {
                if (elapsed == 0) {
                    set_pwm_for_led(leds[i].pwm, true, led_brightness);
                } else {
                    set_pwm_for_led(leds[i].pwm, false, 0);
                }
            }
        }
        k_sleep(K_MSEC(blink_interval_ms));
        elapsed += blink_interval_ms;
    }
}
```

## src/LEDManager.h
```c
#ifndef LEDMANAGER_H
#define LEDMANAGER_H

#ifdef __cplusplus
extern "C" {
#endif
#include <zephyr/drivers/pwm.h>

enum led_state {
    LED_OFF,
    LED_ON,
    LED_BLINK_FAST,
    LED_BLINK_ONCE
};

// Internal LED state struct
struct led_entry {
    enum led_state state;
    const struct pwm_dt_spec *pwm;
};


// Initialize with array of pointers to const struct gpio_dt_spec, and count
int init_led_manager(struct led_entry *led_array, int count);
// Set state by index
int set_led_state(int led_idx, enum led_state state);
// Set brightness (0-100%) - only works if PWM configured
int set_led_brightness(int led_idx, uint8_t brightness_percent);

void operate_leds(int total_interval_ms, int blink_interval_ms);

#ifdef __cplusplus
}
#endif

#endif // LEDMANAGER_H
```

## src/defines.h
```c
#ifndef MODE_DEFS_H
#define MODE_DEFS_H

// Flash
#define NVS_ID_DEVICE_INFO 1 // Device info ID in NVS
#define NVS_ID_STATIC_ADDR 2

// BLE/peer
#define MAC_LEN 6
#define MAX_PEERS 255  // Maximize peer capacity within RAM constraints
#define HASH_PROBE_STEP 7  // Prime number for linear probing step

#define RSSI_THRESHOLD -70 // RSSI threshold for peer discovery
#define LVLUP_TOKEN_RSSI_THRESHOLD -45 // RSSI threshold for level-up token discovery (really close)

// Dynamic RSSI threshold feature:
// - Stored in device_info_t.dynamic_rssi_threshold
// - Can be set via master advertisement for any device mode
// - Value 0 = disabled (use default RSSI_THRESHOLD)
// - If set higher than RSSI_THRESHOLD, effectively no additional filtering
// - Applied to aura and overseer advertisements in device mode, extensible to other modes

// Peer tracking thresholds
#define PEER_DETECTION_THRESHOLD 2  // Consecutive detections needed to include peer in calculations
#define PEER_MISS_THRESHOLD 2       // Consecutive misses before excluding peer from calculations
#define OVERSEER_DETECTION_THRESHOLD 3  // Consecutive detections needed to trust overseer
#define OVERSEER_MISS_THRESHOLD 6       // Consecutive misses before ignoring overseer

// --- Bit-packing Helper Macros ---
// Advertisement data is nibble-packed to reduce air time and RF congestion
#define PACK_MODE_AFFINITY(mode, affinity) (((mode) << 4) | ((affinity) & 0x0F))
#define PACK_LEVEL_STATE(level, state) (((level) << 4) | ((state) & 0x0F) )
#define PACK_AURA_LEVEL_STATE(level, state, affinity) ((affinity != AFFINITY_UNITY ?  ((level) << 4) | ((state) & 0x0F) : (((level & 0x03) << 4) | ((level & 0x30) << 2))) | ((state) & 0x0F))
#define UNPACK_MODE(byte) (((byte) >> 4) & 0x0F)
#define UNPACK_AFFINITY(byte) ((byte) & 0x0F)
#define UNPACK_LEVEL(byte, affinity) (affinity != AFFINITY_UNITY ? ((byte) >> 4) & 0x0F : (((byte) >> 4) & 0x03) || (((byte) >> 2) & 0x30) )
#define UNPACK_STATE(byte) ((byte) & 0x0F)

// --- Protocol/Format Length Defines ---
#define MESH_ADV_LEN 5 // Optimized: [header:2][mode|affinity:1][level|state:1][dynamic_rssi:1]
#define MASTER_ADV_LEN (2 + MAC_LEN + sizeof(device_info_t)) // 2 prefix + MAC + device_info_t structure
#define OVERSEER_ADV_LEN 10 // 2 prefix + 8 bytes for state data (4 levels × 2 affinities)

// Timings - Optimized for 120-130 peer density with responsive device state changes
#define STARTUP_DELAY_MS 5000 // 5 seconds for startup timeout
#define CYCLE_DURATION_MS 3500 // 3.5 second cycle duration - balanced responsiveness/discovery
#define BLINK_INTERVAL_MS 250 // 250ms blink interval for LEDs
#define SCAN_INTERVAL_MS 701  // prime number, ~0.7s
#define ADV_INTERVAL_MS 307   // prime number, ~0.3s
#define SCAN_JITTER_MS 50     // up to +/-50ms random jitter
#define ADV_JITTER_MS 30      // up to +/-30ms random jitter
#define PEER_DISCOVERY_JITTER_MS 120 // Optimal jitter for 120-130 peers (reduced from 200ms)
#define LVLUP_TOKEN_BROADCAST_COUNTDOWN 3 // Broadcast countdown for level-up token
#define OVERSEER_BROADCAST_COUNTDOWN 10 // Broadcast countdown for overseer mode

// --- Aura levels and stuff ---
#define HOSTILE_AURAS_IDX 0 // Index for hostile auras in aura_level_count
#define FRIENDLY_AURAS_IDX 1 // Index for Unity auras in aura_level_count
#define MAGIC_AURAS_IDX 0 // Index for Magic auras in aura_level_count (used by overseer)
#define TECHNO_AURAS_IDX 1 // Index for Techno auras in aura_level_count (used by overseer)
#define MAX_AURA_LEVEL 3 // Maximum aura level (0 to 3)
#define LEVELS_PER_AFFINITY 5 // Levels per affinity type (0, 1, 2, 3, 4 = hostile environment)
#define HOSTILE_ENVIRONMENT_LEVEL 4 // Level for hostile environment
#define HOSTILE_ENVIRONMENT_TRESHOLD 20 // Threshold for staying in hostile environment before becoming affected. 

// --- PINs assignments ---
#define BLUE_LED_PIN 0   // Blue LED index in led_array
#define RED_LED_PIN 1    // Red LED index in led_array
#define GREEN_LED_PIN 2  // Green LED index in led_array


#endif // MODE_DEFS_H
```

## src/errors.h
```c
/* errors.h - Error code definitions */

/*
 * Copyright (c) 2024
 * SPDX-License-Identifier: Apache-2.0
 */

#ifndef ERRORS_H
#define ERRORS_H

// Error codes for BLE Aura Mesh system
// Negative values indicate errors, 0 indicates success

#define ERROR_SUCCESS                       0
#define ERROR_FLASH_NOT_READY              -1
#define ERROR_FLASH_PAGE_INFO              -2
#define ERROR_NVS_MOUNT                    -3
#define ERROR_BT_ENABLE                    -4
#define ERROR_BT_ID_GET                    -5
#define ERROR_ADV_START                    -6
#define ERROR_SCAN_START                   -7
#define ERROR_LED_INIT                     -8
#define ERROR_GPIO_NOT_READY               -9

#endif /* ERRORS_H */
```

## src/types.h
```c
#ifndef MODE_TYPES_H
#define MODE_TYPES_H

#ifdef __cplusplus
extern "C" {
#endif

#include <stdint.h>

typedef enum {
    // MASTER advertisement can change device mode
    ADV_TYPE_MASTER,
    // MESH advertisement is used for advertising device state
    ADV_TYPE_ZEPHYR,
    ADV_TYPE_UNKNOWN
} adv_name_type_t;

typedef enum {
    // Uninitialized or no operation
    MODE_NONE,
    // Aura pendant mode, affects devices around
    MODE_AURA,
    // Device mode, reacts to aura pendants around
    MODE_DEVICE,
    // Level-up token mode, used to level up aura pendants
    MODE_LVLUP_TOKEN,
    // Overseer mode, broadcasts device states to surrounding devices
    MODE_OVERSEER
} operation_mode_t;

typedef enum {
    AFFINITY_UNITY, // Unity device
    AFFINITY_MAGIC, // Magic device
    AFFINITY_TECHNO // Techno device
} affinity_t;

typedef struct {
    uint8_t mode; // operation_mode_t
    uint8_t affinity; // affinity_t
    uint8_t level; // 0 to 3, 4 = hostile environment
    int8_t dynamic_rssi_threshold; // Dynamic RSSI threshold (0 = disabled, use default)
} device_info_t;

typedef enum {
    PEER_SLOT_EMPTY = 0,   // Never used
    PEER_SLOT_OCCUPIED,    // Currently used
    PEER_SLOT_DELETED      // Previously used, now deleted
} peer_slot_state_t;

typedef struct peer {
    peer_slot_state_t state; // Slot state for open addressing
    uint8_t mac[6]; // MAC address
    uint8_t affinity; // affinity_t (removed mode to save memory)
    uint8_t level; // 0 to 3, 4 = hostile environment
    int8_t stability_counter; // Positive: consecutive detections, Negative: consecutive misses
    uint8_t detected_this_cycle : 1; // Flag set if detected in current cycle
    uint8_t is_established : 1; // Flag set once peer reaches PEER_DETECTION_THRESHOLD
    uint8_t reserved : 6; // Reserved bits for future use
} peer_t;

typedef struct {
    uint8_t is_on;
    // Overseer tracking
    uint8_t overseer_mac[6]; // MAC of strongest overseer
    uint8_t tracked_mac[6]; // MAC of currently tracked overseer
    int8_t overseer_rssi; // RSSI of strongest overseer
    int8_t overseer_stability_counter; // Stability counter for overseer signal
    uint8_t overseer_detected_this_cycle : 1; // Overseer detected this cycle
    uint8_t overseer_state : 1; // State commanded by overseer
    uint8_t use_overseer : 1; // Use overseer state instead of internal calculation
    uint8_t reserved : 5; // Reserved bits
} mode_device_state_t;

typedef struct {
    uint8_t is_active; // Is the aura pendant active?
    uint8_t is_in_hostile_environment; // Is the aura pendant in hostile environment?
    uint8_t hostility_counter; // How long staying in hostile environment
} mode_aura_state_t;

typedef struct {
    uint8_t mac[6]; // MAC address of receiving aura pendant
    device_info_t device_info; // Device info to broadcast
    uint8_t broadcast_countdown; // Countdown for broadcasting
} mode_lvlup_token_state_t;

typedef struct {
    uint8_t broadcast_countdown; // Countdown for broadcasting device states
} mode_overseer_state_t;

typedef union {
    mode_device_state_t device;
    mode_aura_state_t aura;
    mode_lvlup_token_state_t lvlup_token;
    mode_overseer_state_t overseer;
} mode_state_t;


#ifdef __cplusplus
}
#endif

#endif // MODE_TYPES_H
```
